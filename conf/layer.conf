## conf/layer.conf
```bitbake
# Copyright (C) 2018-2022 SanCloud Ltd
# SPDX-License-Identifier: MIT

# We have a conf and classes directory, append to BBPATH
BBPATH .= ":${LAYERDIR}"

# We have a recipes directory containing .bb and .bbappend files, add to BBFILES
BBFILES += "${LAYERDIR}/recipes-*/*/*.bb \
            ${LAYERDIR}/recipes-*/*/*.bbappend"

BBFILE_COLLECTIONS += "meta-sancloud"
BBFILE_PATTERN_meta-sancloud := "^${LAYERDIR}/"
BBFILE_PRIORITY_meta-sancloud = "9"

LAYERSERIES_COMPAT_meta-sancloud = "dunfell"
LAYERDEPENDS_meta-sancloud = " \
    core \
    meta-ti \
    rtlwifi \
    "

BBFILES_DYNAMIC += " \
    meta-arago-distro:${LAYERDIR}/dynamic-layers/meta-arago-distro/*/*/*.bbappend \
    "

SANCLOUD_BSP_VERSION = "6.1.0"
IMAGE_BUILDINFO_VARS_append = " SANCLOUD_BSP_VERSION"
```

## conf/machine/bbe.conf
```bitbake
# Copyright (C) 2018-2022 SanCloud Ltd
# SPDX-License-Identifier: MIT

#@TYPE: Machine
#@NAME: SanCloud BeagleBone Enhanced Development Board
#@DESCRIPTION: Machine configuration for the BeagleBone Enhanced https://sancloud.co.uk/beaglebone-enhanced-bbe/

################################################################################
# Basic machine config

MACHINEOVERRIDES =. "beaglebone:"

IMAGE_FSTYPES = "tar.xz wic.xz wic.bmap"
WKS_FILE ?= "sancloud_bbe.wks"
WICVARS:append = " IMAGE_OVERHEAD_FACTOR"

require conf/machine/include/ti33x.inc

BBE_WIFI_DRIVERS ?= "rtl8723bu qcacld"
MACHINE_EXTRA_RDEPENDS += "u-boot-script-bbe kernel-modules ${BBE_WIFI_DRIVERS}"
SERIAL_CONSOLE = "115200 ttyS0"
MACHINE_FEATURES += "bluetooth"

################################################################################
# U-boot

PREFERRED_PROVIDER_virtual/bootloader = "u-boot-bbe"
PREFERRED_PROVIDER_u-boot = "u-boot-bbe"
EXTRA_IMAGEDEPENDS += "u-boot-bbe"

SPL_BINARY = "MLO"
UBOOT_SUFFIX = "img"
UBOOT_MACHINE = "sancloud_defconfig"

IMAGE_BOOT_FILES = ""

################################################################################
# Kernel

KERNEL_DEVICETREE = " \
    am335x-sancloud-bbe.dtb \
    "
KERNEL_EXTRA_ARGS += "LOADADDR=${UBOOT_ENTRYPOINT}"

BBE_KERNEL_PROVIDER ??= "default"
require conf/machine/include/bbe-kernel-${BBE_KERNEL_PROVIDER}.inc

BBE_SPIBOOT ??= "0"
require ${@bb.utils.contains('BBE_SPIBOOT', '1', 'conf/machine/include/bbe-spiboot.inc', '', d)}
```

## conf/machine/include/bbe-kernel-bb.org.inc
```bitbake
# Copyright (C) 2020-2022 SanCloud Ltd
# SPDX-License-Identifier: MIT

PREFERRED_PROVIDER_virtual/kernel:bbe = "linux-bb.org"
KERNEL_DEVICETREE += " \
    am335x-sancloud-bbe-extended-wifi.dtb \
    am335x-sancloud-bbe-lite.dtb \
    "
```

## conf/machine/include/bbe-kernel-default-5.10.inc
```bitbake
PREFERRED_PROVIDER_virtual/kernel_bbe = "linux-bbe"
PREFERRED_VERSION_linux-bbe = "5.10%"
KERNEL_DEVICETREE += " \
    am335x-sancloud-bbe-extended-wifi.dtb \
    am335x-sancloud-bbe-lite.dtb \
    "
BBE_WIFI_DRIVERS = ""
```

## conf/machine/include/bbe-kernel-default.inc
```bitbake
# Copyright (C) 2020-2022 SanCloud Ltd
# SPDX-License-Identifier: MIT

PREFERRED_PROVIDER_virtual/kernel:bbe = "linux-bbe"
KERNEL_DEVICETREE += " \
    am335x-sancloud-bbe-extended-wifi.dtb \
    am335x-sancloud-bbe-lite.dtb \
    "
```

## conf/machine/include/bbe-kernel-lts.inc
```bitbake
require conf/machine/include/bbe-kernel-stable.inc
PREFERRED_VERSION_linux-stable = "5.4%"
```

## conf/machine/include/bbe-kernel-mainline.inc
```bitbake
# Copyright (C) 2020-2022 SanCloud Ltd
# SPDX-License-Identifier: MIT

require conf/linux-mainline/mainline.inc

KBUILD_DEFCONFIG = "multi_v7_defconfig"
KCONFIG_MODE = "alldefconfig"
BBE_WIFI_DRIVERS = ""
RDEPENDS_${KERNEL_PACKAGE_NAME}-base += "${KERNEL_PACKAGE_NAME}-devicetree"
```

## conf/machine/include/bbe-kernel-next.inc
```bitbake
PREFERRED_PROVIDER_virtual/kernel = "linux-bbe-next"
KERNEL_DEVICETREE += " \
    am335x-sancloud-bbe-extended-wifi.dtb \
    am335x-sancloud-bbe-lite.dtb \
    "
```

## conf/machine/include/bbe-kernel-rt-next.inc
```bitbake
# Copyright (C) 2020-2022 SanCloud Ltd
# SPDX-License-Identifier: MIT

PREFERRED_PROVIDER_virtual/kernel_bbe = "linux-bbe-rt-next"
KERNEL_DEVICETREE += " \
    am335x-sancloud-bbe-extended-wifi.dtb \
    am335x-sancloud-bbe-lite.dtb \
    "
```

## conf/machine/include/bbe-kernel-rt.inc
```bitbake
# Copyright (C) 2020-2022 SanCloud Ltd
# SPDX-License-Identifier: MIT

PREFERRED_PROVIDER_virtual/kernel:bbe = "linux-bbe-rt"
KERNEL_DEVICETREE += " \
    am335x-sancloud-bbe-extended-wifi.dtb \
    am335x-sancloud-bbe-lite.dtb \
    "
```

## conf/machine/include/bbe-kernel-stable.inc
```bitbake
require conf/machine/include/bbe-kernel-mainline.inc
PREFERRED_PROVIDER_virtual/kernel_bbe = "linux-stable"
```

## conf/machine/include/bbe-spiboot.inc
```bitbake
# Copyright (C) 2022 SanCloud Ltd
# SPDX-License-Identifier: MIT

SPL_BINARY = "MLO.byteswap"
UBOOT_MACHINE = "sancloud_spiboot_defconfig"

BBE_WIFI_DRIVERS = ""
KBUILD_DEFCONFIG = "sancloud_tiny_defconfig"
KERNEL_CLASSES = "kernel-fitimage"
KERNEL_IMAGETYPES:append = " fitImage"
KERNEL_DEVICETREE = "am335x-sancloud-bbe-lite.dtb"
INITRAMFS_IMAGE = "sancloud-ramdisk-image"

kernel_do_deploy:append() {
    # Deploy a consistently named symlink for the complete fitImage
    # (which includes the initramfs)
    ln -snf fitImage-${INITRAMFS_IMAGE_NAME}-${KERNEL_FIT_NAME}.bin "$deployDir/fitImage-complete-${MACHINE}.bin"
    ln -snf fitImage-${INITRAMFS_IMAGE_NAME}-${KERNEL_FIT_NAME}.bin "$deployDir/fitImage-complete.bin"
}
```

## meta-sancloud-agl/conf/layer.conf
```bitbake
# We have a conf and classes directory, append to BBPATH
BBPATH .= ":${LAYERDIR}"

# We have a recipes directory containing .bb and .bbappend files, add to BBFILES
BBFILES += "${LAYERDIR}/recipes-*/*/*.bb \
            ${LAYERDIR}/recipes-*/*/*.bbappend"

BBFILE_COLLECTIONS += "meta-sancloud-agl"
BBFILE_PATTERN_meta-sancloud-agl := "^${LAYERDIR}/"
BBFILE_PRIORITY_meta-sancloud-agl = "9"

LAYERDEPENDS_meta-sancloud-agl = " \
    core \
    meta-ti \
    meta-sancloud \
    "
```

## meta-sancloud-arago/conf/layer.conf
```bitbake
# We have a conf and classes directory, append to BBPATH
BBPATH .= ":${LAYERDIR}"

# We have a recipes directory containing .bb and .bbappend files, add to BBFILES
BBFILES += "${LAYERDIR}/recipes-*/*/*.bb \
            ${LAYERDIR}/recipes-*/*/*.bbappend"

BBFILE_COLLECTIONS += "meta-sancloud-arago"
BBFILE_PATTERN_meta-sancloud-arago := "^${LAYERDIR}/"
BBFILE_PRIORITY_meta-sancloud-arago = "9"

LAYERSERIES_COMPAT_meta-sancloud-arago = "thud"
LAYERDEPENDS_meta-sancloud-arago = " \
    core \
    meta-ti \
    meta-sancloud \
    "
```
